## arch/arm/configs/apq8084_sec_trlte_spr_defconfig
```kconfig
#Disabled for UBports
# CONFIG_NETPRIO_CGROUP=y
# CONFIG_BRIDGE=y
# CONFIG_SECURITY_SELINUX_BOOTPARAM=y
# CONFIG_EPOLL=y

#Added for AppArmor Patch
#CONFIG_SECURITY_APPARMOR_COMPAT_24=y

#Added for UBPorts
CONFIG_BRIDGE=y
CONFIG_NAMESPACES=y
#CONFIG_USER_NS=y <= ecryptfs error
CONFIG_AUDIT=y
CONFIG_AUDITSYSCALL=y
CONFIG_AUDIT_TREE=y
CONFIG_AUDIT_WATCH=y
CONFIG_CC_STACKPROTECTOR=y
CONFIG_DEBUG_RODATA=y
CONFIG_ECRYPT_FS=y
CONFIG_ECRYPT_FS_MESSAGING=y
CONFIG_ENCRYPTED_KEYS=y
CONFIG_EXT4_FS_POSIX_ACL=y
CONFIG_EXT4_FS_SECURITY=y
CONFIG_FSNOTIFY=y
CONFIG_DNOTIFY=y
CONFIG_FANOTIFY_ACCESS_PERMISSIONS=y
CONFIG_KEYS=y
CONFIG_SWAP=y
CONFIG_VT_CONSOLE=y
CONFIG_SECURITY=y
CONFIG_SECURITYFS=y
CONFIG_SECURITY_NETWORK=y
CONFIG_NETLABEL=y
CONFIG_SECURITY_PATH=y
CONFIG_SECURITY_SELINUX=y
CONFIG_SECURITY_SELINUX_DISABLE=y
CONFIG_SECURITY_SELINUX_DEVELOP=y
CONFIG_SECURITY_SELINUX_AVC_STATS=y
CONFIG_SECURITY_SMACK=y
CONFIG_SECURITY_TOMOYO=y
# CONFIG_DEFAULT_SECURITY was y
CONFIG_DEFAULT_SECURITY="apparmor"
CONFIG_SECURITY_APPARMOR=y
CONFIG_SECURITY_APPARMOR_HASH=y
CONFIG_SECURITY_APPARMOR_UNCONFINED_INIT=y
CONFIG_SECURITY_YAMA=y
CONFIG_SECURITY_YAMA_STACKED=y
CONFIG_STRICT_DEVMEM=y
CONFIG_SYN_COOKIES=y
CONFIG_BT_RFCOMM_TTY=y
CONFIG_BT_BNEP=y
CONFIG_BT_BNEP_MC_FILTER=y
CONFIG_BT_BNEP_PROTO_FILTER=y
CONFIG_BT_HIDP=y
CONFIG_XFRM_USER=y
CONFIG_NET_KEY=y
CONFIG_INET=y
CONFIG_IP_ADVANCED_ROUTER=y
CONFIG_INET_AH=y
CONFIG_INET_ESP=y
CONFIG_INET_IPCOMP=y
CONFIG_INET_XFRM_MODE_TRANSPORT=y
CONFIG_INET_XFRM_MODE_TUNNEL=y
CONFIG_INET_XFRM_MODE_BEET=y
CONFIG_INET6_AH=y
CONFIG_INET6_ESP=y
CONFIG_INET6_IPCOMP=y
CONFIG_INET6_XFRM_MODE_TRANSPORT=y
CONFIG_INET6_XFRM_MODE_TUNNEL=y
CONFIG_INET6_XFRM_MODE_BEET=y
CONFIG_IPV6_MULTIPLE_TABLES=y
CONFIG_NETFILTER=y
CONFIG_NETFILTER_ADVANCED=y
CONFIG_NETFILTER_NETLINK=y
CONFIG_NETFILTER_NETLINK_LOG=y
CONFIG_NETFILTER_NETLINK_QUEUE=y
CONFIG_NETFILTER_TPROXY=y
CONFIG_NETFILTER_XTABLES=y
CONFIG_NETFILTER_XT_MARK=y
CONFIG_NETFILTER_XT_MATCH_ADDRTYPE=y
CONFIG_NETFILTER_XT_MATCH_CLUSTER=y
CONFIG_NETFILTER_XT_MATCH_COMMENT=y
CONFIG_NETFILTER_XT_MATCH_CONNBYTES=y
CONFIG_NETFILTER_XT_MATCH_CONNLIMIT=y
CONFIG_NETFILTER_XT_MATCH_CONNTRACK=y
CONFIG_NETFILTER_XT_MATCH_CPU=y
CONFIG_NETFILTER_XT_MATCH_DCCP=y
CONFIG_NETFILTER_XT_MATCH_DEVGROUP=y
CONFIG_NETFILTER_XT_MATCH_DSCP=y
CONFIG_NETFILTER_XT_MATCH_ECN=y
CONFIG_NETFILTER_XT_MATCH_ESP=y
CONFIG_NETFILTER_XT_MATCH_HASHLIMIT=y
CONFIG_NETFILTER_XT_MATCH_HELPER=y
CONFIG_NETFILTER_XT_MATCH_HL=y
CONFIG_NETFILTER_XT_MATCH_IPRANGE=y
CONFIG_NETFILTER_XT_MATCH_LENGTH=y
CONFIG_NETFILTER_XT_MATCH_LIMIT=y
CONFIG_NETFILTER_XT_MATCH_MAC=y
CONFIG_NETFILTER_XT_MATCH_MARK=y
CONFIG_NETFILTER_XT_MATCH_MULTIPORT=y
CONFIG_NETFILTER_XT_MATCH_OSF=y
CONFIG_NETFILTER_XT_MATCH_OWNER=y
CONFIG_NETFILTER_XT_MATCH_PKTTYPE=y
CONFIG_NETFILTER_XT_MATCH_POLICY=y
CONFIG_NETFILTER_XT_MATCH_QUOTA=y
CONFIG_NETFILTER_XT_MATCH_QUOTA2=y
CONFIG_NETFILTER_XT_MATCH_RATEEST=y
CONFIG_NETFILTER_XT_MATCH_REALM=y
CONFIG_NETFILTER_XT_MATCH_RECENT=y
CONFIG_NETFILTER_XT_MATCH_SCTP=y
CONFIG_NETFILTER_XT_MATCH_SOCKET=y
CONFIG_NETFILTER_XT_MATCH_STATE=y
CONFIG_NETFILTER_XT_MATCH_STATISTIC=y
CONFIG_NETFILTER_XT_MATCH_STRING=y
CONFIG_NETFILTER_XT_MATCH_TCPMSS=y
CONFIG_NETFILTER_XT_MATCH_TIME=y
CONFIG_NETFILTER_XT_MATCH_U32=y
CONFIG_NETFILTER_XT_TARGET_AUDIT=y
CONFIG_NETFILTER_XT_TARGET_CHECKSUM=y
CONFIG_NETFILTER_XT_TARGET_CLASSIFY=y
CONFIG_NETFILTER_XT_TARGET_CONNSECMARK=y
CONFIG_NETFILTER_XT_TARGET_CT=y
CONFIG_NETFILTER_XT_TARGET_DSCP=y
CONFIG_NETFILTER_XT_TARGET_HL=y
CONFIG_NETFILTER_XT_TARGET_IDLETIMER=y
CONFIG_NETFILTER_XT_TARGET_LED=y
CONFIG_NETFILTER_XT_TARGET_LOG=y
CONFIG_NETFILTER_XT_TARGET_MARK=y
CONFIG_NETFILTER_XT_TARGET_NFLOG=y
CONFIG_NETFILTER_XT_TARGET_NFQUEUE=y
CONFIG_NETFILTER_XT_TARGET_NOTRACK=y
CONFIG_NETFILTER_XT_TARGET_RATEEST=y
CONFIG_NETFILTER_XT_TARGET_SECMARK=y
CONFIG_NETFILTER_XT_TARGET_TCPMSS=y
CONFIG_NETFILTER_XT_TARGET_TCPOPTSTRIP=y
CONFIG_NETFILTER_XT_TARGET_TEE=y
CONFIG_NETFILTER_XT_TARGET_TPROXY=y
CONFIG_NETFILTER_XT_TARGET_TRACE=y
CONFIG_NF_CONNTRACK_ZONES=y
CONFIG_IP6_NF_FILTER=y
CONFIG_IP6_NF_IPTABLES=y
CONFIG_IP6_NF_MANGLE=y
CONFIG_IP6_NF_MATCH_AH=y
CONFIG_IP6_NF_MATCH_EUI64=y
CONFIG_IP6_NF_MATCH_FRAG=y
CONFIG_IP6_NF_MATCH_HL=y
CONFIG_IP6_NF_MATCH_IPV6HEADER=y
CONFIG_IP6_NF_MATCH_MH=y
CONFIG_IP6_NF_MATCH_OPTS=y
CONFIG_IP6_NF_MATCH_RPFILTER=y
CONFIG_IP6_NF_MATCH_RT=y
CONFIG_IP6_NF_QUEUE=y
CONFIG_IP6_NF_RAW=y
CONFIG_IP6_NF_SECURITY=y
CONFIG_IP6_NF_TARGET_HL=y
CONFIG_IP6_NF_TARGET_REJECT=y
CONFIG_IP6_NF_TARGET_REJECT_SKERR=y
CONFIG_DNS_RESOLVER=y
CONFIG_IOSCHED_DEADLINE=y
CONFIG_SUSPEND_TIME=y
CONFIG_CORE_DUMP_DEFAULT_ELF_HEADERS=y
CONFIG_CONSOLE_TRANSLATIONS=y
CONFIG_EVM=y
CONFIG_INTEGRITY_SIGNATURE=y
CONFIG_SECURITY_APPARMOR_BOOTPARAM_VALUE=1
CONFIG_SECURITY_SELINUX_BOOTPARAM_VALUE=0
CONFIG_SECURITY_SELINUX_CHECKREQPROT_VALUE=1
CONFIG_SECURITY_TOMOYO_MAX_ACCEPT_ENTRY=2048
CONFIG_SECURITY_TOMOYO_MAX_AUDIT_LOG=1024
CONFIG_SECURITY_TOMOYO_POLICY_LOADER="/sbin/tomoyo-init"
CONFIG_SECURITY_TOMOYO_ACTIVATION_TRIGGER="/sbin/init"
CONFIG_DEFAULT_MMAP_MIN_ADDR=32768
CONFIG_DEFAULT_IOSCHED="deadline"
CONFIG_EVM_HMAC_VERSION=2
CONFIG_DEFAULT_SECURITY_APPARMOR=y
CONFIG_SECURITY_SELINUX_BOOTPARAM=n


#Added for Halium Testing
CONFIG_PROC_FS=y
CONFIG_CGROUP_PERF=y
CONFIG_SYSFS=y
CONFIG_TIMERFD=y
CONFIG_SECCOMP=y
CONFIG_SIGNALFD=y
CONFIG_CGROUP_FREEZER=y
CONFIG_BLK_CGROUP=y
CONFIG_BT=y
CONFIG_UTS_NS=y
CONFIG_CGROUP_MEM_RES_CTLR_KMEM=y
CONFIG_NETFILTER_XT_MATCH_NFACCT=y
CONFIG_EPOLL=y
CONFIG_CGROUP_SCHED=y
CONFIG_IP_NF_IPTABLES=y
CONFIG_HIDRAW=y
CONFIG_NETFILTER_XT_TARGET_CONNMARK=y
CONFIG_EXT4_FS=y
CONFIG_DEVTMPFS=y
CONFIG_SYSVIPC=y
CONFIG_RTC_DRV_CMOS=y
CONFIG_NET_NS=y
CONFIG_CGROUP_MEM_RES_CTLR_SWAP=y
CONFIG_CGROUP_MEM_RES_CTLR=y
CONFIG_CGROUP_CPUACCT=y
CONFIG_IP_NF_TARGET_MASQUERADE=y
CONFIG_VT=y
CONFIG_NLS_UTF8=y
CONFIG_NET=y
CONFIG_ANDROID_LOW_MEMORY_KILLER=y
CONFIG_NETFILTER_NETLINK_ACCT=y
CONFIG_UNIX=y
CONFIG_IPV6=y
CONFIG_PID_NS=y
CONFIG_IPC_NS=y
CONFIG_CGROUPS=y
CONFIG_CHECKPOINT_RESTORE=y
CONFIG_NETFILTER_XT_MATCH_CONNMARK=y
CONFIG_FHANDLE=y
CONFIG_UEVENT_HELPER_PATH=""
CONFIG_RD_GZIP=y
CONFIG_TMPFS_XATTR=y
CONFIG_TMPFS_POSIX_ACL=y
CONFIG_IP_MULTIPLE_TABLES=y
CONFIG_TUN=y
CONFIG_CGROUP_DEVICE=y
CONFIG_NETFILTER_XT_CONNMARK=y
CONFIG_DEVTMPFS_MOUNT=y
CONFIG_LBDAF=y
CONFIG_SCHEDSTATS=y
CONFIG_AUTOFS4_FS=y
CONFIG_INOTIFY_USER=y
CONFIG_IKCONFIG=y
CONFIG_IKCONFIG_PROC=y
# CONFIG_WATCHDOG_NOWAYOUT=y
CONFIG_SCHED_DEBUG=y
CONFIG_FANOTIFY=y
CONFIG_NET_CLS_CGROUP=y
# CONFIG_BT_HCIUART=y
# CONFIG_BT_RFCOMM=!
# CONFIG_BT_HCIUART_H4=y
# CONFIG_SND_SOC=y


# Added for BT Testing
CONFIG_BT=y
CONFIG_BT_HCIUART=y
#CONFIG_BT_RFCOMM=y
CONFIG_BT_HCIUART_H4=y
CONFIG_BT_BREDR=y
CONFIG_RFKILL=y
CONFIG_RFCOMM_TTY=y
#CONFIG_OF=y

#Added for LXC Container
CONFIG_NF_NAT_IPV6=y
CONFIG_IP6_NF_TARGET_MASQUERADE=y
CONFIG_NETFILTER_XT_TARGET_CHECKSUM=y
CONFIG_UNIX_DIAG=y
#CONFIG_PACKET_DIAG=m
CONFIG_NETLINK_DIAG=y
CONFIG_DEVPTS_MULTIPLE_INSTANCES=y
CONFIG_CPUSETS=y
CONFIG_CGROUP_MEM_RES_CTLR=y
CONFIG_CGROUP_CPUSET=y
CONFIG_CGROUP_BFQIO=y
CONFIG_MEMCG=y

#Added for Ping (Modifying some kernel files needed)
CONFIG_SECURITY_ANDROID_GID_CAPABILITIES=y


CONFIG_SEC_TRLTE_PROJECT=y
CONFIG_MACH_TRLTE_SPR=y
#
# MAX77828 IC
#
CONFIG_EXTCON=y
CONFIG_EXTCON_MAX77828=y
CONFIG_MFD_MAX77828=y
CONFIG_EXTCON_MAX77843=y
CONFIG_MFD_MAX77843=y
CONFIG_MUIC_SUPPORT_HMT_DETECTION=y
CONFIG_MUIC_SUPPORT_DESK_DOCK=y
CONFIG_MUIC_SUPPORT_SMART_DOCK=y
CONFIG_MUIC_SUPPORT_QC_CHARGER=y
CONFIG_MOTOR_DRV_MAX77828=y
CONFIG_MOTOR_DRV_MAX77843=y
# CONFIG_TACTILE_ASSIST is not set
CONFIG_VIBETONZ=y
CONFIG_LEDS_MAX77828=y
#
# GPIO EXPANDER
#
CONFIG_GPIO_PCAL6416A=y
#
# IDCHIP
#
#CONFIG_INPUT_HALLIC=y
CONFIG_SENSORS_HALL=y
CONFIG_W1=y
CONFIG_W1_MASTER_GPIO_MSM=y
CONFIG_W1_SLAVE_DS28EL35=y
CONFIG_W1_WORKQUEUE=y
CONFIG_W1_FAST_CHECK=y
CONFIG_W1_SN=y
#
# Battery & Charger
#
# CONFIG_SMB350_CHARGER is not set
# CONFIG_BATTERY_BQ28400 is not set
# CONFIG_BATTERY_MSM is not set
# CONFIG_FUELGAUGE_DUMMY is not set
#
# MAX77823 Charger
#
# CONFIG_QPNP_CHARGER is not set
# CONFIG_QPNP_BMS is not set
CONFIG_FUELGAUGE_MAX77843=y
CONFIG_FUELGAUGE_MAX77843_COULOMB_COUNTING=y
CONFIG_CHARGER_MAX77843=y
CONFIG_SAMSUNG_LPM_MODE=y
CONFIG_BATTERY_SAMSUNG=y
CONFIG_BATTERY_SAMSUNG_DATA_FILE="tr_battery_data.h"
CONFIG_AFC_CHARGER_MODE=y
#
# NFC
#
CONFIG_SEC_NFC_I2C=y
CONFIG_SEC_NFC=y
CONFIG_SEC_NFC_PRODUCT_N5=y
CONFIG_NFC_N5_8084_USE_BBCLK2=y
CONFIG_SEC_NFC_MARGINTIME=y
# CONFIG_NFC_PN547 is not set
# CONFIG_NFC_PN547_8084_USE_BBCLK2 is not set

#
# LCD PANEL INFO
#
CONFIG_PANEL_S6E3HA2_AMS567DJ01_WQHD=y
#
# TSP,Tkey,Wacom
#
# CONFIG_TOUCHSCREEN_SYNAPTICS_I2C_RMI_G is not set
CONFIG_TOUCHSCREEN_STM=y
CONFIG_KEYBOARD_CYPRESS_TOUCHKEY_T=y
CONFIG_INPUT_WACOM=y
CONFIG_INPUT_BOOSTER=y
CONFIG_WACOM_LCD_FREQ_COMPENSATE=y
#
# Finger print sensor
#
CONFIG_SENSORS_FINGERPRINT=y
CONFIG_SENSORS_FINGERPRINT_SYSFS=y
CONFIG_SENSORS_VFS61XX=y
CONFIG_SENSORS_VFS61XX_KO=y

# SensorHub
CONFIG_SENSORS_SSP=y
CONFIG_SENSORS_SYSFS=y
CONFIG_SENSORS_SSP_ATMEL=y
CONFIG_SENSORS_SSP_SENSORHUB=y
CONFIG_SENSORS_SSP_FACTORY=y
CONFIG_SENSORS_SSP_ICM20610=y
CONFIG_SENSORS_SSP_LPS25H=y
CONFIG_SENSORS_SSP_AK09911C=y
CONFIG_SENSORS_SSP_TMG399X=y
CONFIG_SENSORS_SSP_MOBEAM=y
CONFIG_SENSORS_SSP_ATUC128L5HAR=y
CONFIG_SENSORS_SSP_DIRECTION_EXCEPTION=y
CONFIG_IIO=y
CONFIG_IIO_BUFFER=y
CONFIG_IIO_KFIFO_BUF=y
CONFIG_IIO_TRIGGER=y

# Hrm Sensor + UV sensor
CONFIG_SENSORS_MAX86902=y
CONFIG_SENSORS_MAX_NOTCHFILTER=y
CONFIG_SENSORS_ADPD142=y
CONFIG_AVERAGE=y

#
# CAMERA
#
CONFIG_S5K2P2XX=y
CONFIG_COMPANION=y
CONFIG_OIS=y
CONFIG_LEDS_MAX77828=y
CONFIG_LEDS_MIC2873=y
CONFIG_DEBUG_FLASH is not set

CONFIG_LEDS_MAX77828_RGB=y
CONFIG_LEDS_MAX77843_RGB=y
#CONFIG IR LED
CONFIG_SEC_FPGA_ICE40XX=y

# Earjack
CONFIG_SAMSUNG_JACK=y
CONFIG_INPUT_GPIO=y

# MHI
CONFIG_MSM_MHI=y
CONFIG_MSM_MHI_UCI=y
CONFIG_MSM_RMNET_MHI=y

# MHL
CONFIG_SEC_MHL_SII8620=y

# SUB PMIC
CONFIG_REGULATOR_MAX77826=y
CONFIG_REGULATOR_S2MPB01=y

# SSWAP
CONFIG_SWAP=y
CONFIG_FRONTSWAP=y
CONFIG_ZSMALLOC_NEW=y
CONFIG_PGTABLE_MAPPING=y
CONFIG_ZSWAP=y
CONFIG_DIRECT_RECLAIM_FILE_PAGES_ONLY=n
CONFIG_INCREASE_MAXIMUM_SWAPPINESS=y
CONFIG_FIX_INACTIVE_RATIO=y
CONFIG_TIGHT_PGDAT_BALANCE=y
CONFIG_VNSWAP=y
CONFIG_SWAP_ENABLE_READAHEAD=n
# DSM Solution
CONFIG_SND_SOC_MAX98504=y
CONFIG_SND_SOC_MAXIM_DSM=y
#3MIC
CONFIG_SND_SOC_3MIC_SUPPORT=y
# VEQ
CONFIG_SND_SOC_VEQ_SUPPORT=y

# Wifi features
CONFIG_WLAN_REGION_CODE=404
# ItsOn Config
CONFIG_MODULES=y
```
